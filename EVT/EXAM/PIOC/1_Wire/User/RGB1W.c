/********************************** (C) COPYRIGHT *******************************
 * File Name          : RGB1W.c
 * Author             : WCH
 * Version            : V1.0.1
 * Date               : 2023/11/11
 * Description        : 1-wire example 1W-RGB, 1W-DS1820
 *********************************************************************************
 * Copyright (c) 2021 Nanjing Qinheng Microelectronics Co., Ltd.
 * Attention: This software (modified or not) and binary are used for
 * microcontroller manufactured by Nanjing Qinheng Microelectronics.
 *******************************************************************************/

const unsigned char PIOC_1W_CODE[] =
{0x00,0x00,0x00,0x00,0x00,0x00,0x00,0x00,0x16,0x60,0x00,0x00,0x00,0x00,0x00,0x00,   /* .........`...... */
 0x00,0x00,0x0A,0x70,0x00,0x00,0x00,0x00,0x00,0x00,0x00,0x00,0x00,0x00,0x00,0x00,   /* ...p............ */
 0x00,0x00,0x00,0x00,0x00,0x00,0x30,0x00,0x00,0x00,0x00,0x00,0x1C,0x5E,0x1C,0x47,   /* ......0......^.G */
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 0xF0,0x71,0x30,0x00,0x00,0x00};    /* .q0... */


#include "RGB1W.h"
#include <string.h>

__IO	uint8_t		stat;

void PIOC_IRQHandler(void) __attribute__((interrupt("WCH-Interrupt-fast")));

/*********************************************************************
 * @fn      PIOC_IRQHandler
 *
 * @brief   This function handles PIOC exception.
 *
 * @return  none
 */
void PIOC_IRQHandler( void )
{
//	uint8_t	stat;
	stat = PIOC->D8_CTRL_RD;//auto remove interrupt request after reading
//	if ( stat == RGB1W_ERR_OK ) printf("1-wire finished\r\n");
//	else printf("1-wire error %02x\r\n", stat);
//	temper = PIOC->D16_DATA_REG0_1;//for DS1820 only
}

/*********************************************************************
 * @fn      RGB1W_Init
 *
 * @brief   Init RGB1W.
 *
 * @return  none
 */
void RGB1W_Init ( void ) {
    GPIO_InitTypeDef GPIO_InitStructure = {0};

    RCC_APB2PeriphClockCmd(RCC_APB2Periph_AFIO | RCC_APB2Periph_GPIOC, ENABLE);
    RCC_AHBPeriphClockCmd(RCC_AHBPeriph_IO2W, ENABLE);

#if 1  //PC18 PC19
    GPIO_PinRemapConfig(GPIO_Remap_SWJ_Disable, ENABLE);
    GPIO_SetBits(GPIOC, GPIO_Pin_18);

    GPIO_InitStructure.GPIO_Pin = GPIO_Pin_18|GPIO_Pin_19;
    GPIO_InitStructure.GPIO_Mode = GPIO_Mode_AF_PP;
    GPIO_InitStructure.GPIO_Speed = GPIO_Speed_50MHz;
    GPIO_Init(GPIOC, &GPIO_InitStructure);

#else  //PC7
    GPIO_PinRemapConfig(GPIO_Remap_PIOC, ENABLE);
    GPIO_SetBits(GPIOC, GPIO_Pin_7);

    GPIO_InitStructure.GPIO_Pin = GPIO_Pin_7;
    GPIO_InitStructure.GPIO_Mode = GPIO_Mode_AF_PP;
    GPIO_InitStructure.GPIO_Speed = GPIO_Speed_50MHz;
    GPIO_Init(GPIOC, &GPIO_InitStructure);
#endif

//	PIOC->D8_SYS_CFG = 0;//halt
	PIOC->D8_SYS_CFG = RB_MST_RESET | RB_MST_IO_EN0| RB_MST_IO_EN1;	// reset PIOC & enable IO0 IO1

	memcpy( (uint8_t *)(PIOC_SRAM_BASE), PIOC_1W_CODE, sizeof( PIOC_1W_CODE ) );	// load code for PIOC

#if defined SYSCLK_FREQ_24MHz_HSI
	*(uint32_t)(PIOC_SRAM_BASE+PIOC_FREQ_CFG) = 0x00300030;	// set if Fsys=24MHz, default Fsys=48MHz
#else	// default is 48MHz

#endif

//    NVIC_EnableIRQ(PIOC_IRQn);//enable interrupt
//    NVIC_SetPriority(PIOC_IRQn,0xf0);
}

/*********************************************************************
 * @fn      RGB1W_SendSFR
 *
 * @brief   SFR mode for 1~32 bytes data.
 *
 * @param   total_bytes - total data number(byte).
 *          p_source_addr - data.
 *          mod - 0:PC18 or PC7
 *                1:PC19
 *
 * @return  none
 */
void RGB1W_SendSFR( uint16_t total_bytes, uint8_t *p_source_addr ,uint8_t mod) {//SFR mode for 1~32 bytes data
// p_source_addr: point source data buffer start address, set NULL if copy into PIOC buffer already
	if ( total_bytes > RGB1W_SFR_SIZE ) return;
	PIOC->D8_SYS_CFG = RB_MST_RESET | RB_MST_IO_EN0| RB_MST_IO_EN1;//clear&halt PIOC
	PIOC->D8_SYS_CFG = RB_MST_CLK_GATE | RB_MST_IO_EN0| RB_MST_IO_EN1;//run PIOC before write SFR
	if ( p_source_addr ) memcpy( RGB1W_SFR_ADDR, p_source_addr, total_bytes );//copy source data to RGB1W SFR, @PIOC run
	if(mod)
	    RGB1W_COMMAND = ((uint8_t)total_bytes|0X40);// PIOC start send
	else
	    RGB1W_COMMAND = (uint8_t)total_bytes;// PIOC start send

}

/*********************************************************************
 * @fn      RGB1W_SendRAM
 *
 * @brief   RAM mode for 1~3072 bytes data.
 *
 * @param   total_bytes - total data number(byte).
 *          p_source_addr - data.
 *          mod - 0:PC18 or PC7
 *                1:PC19
 *
 * @return  none
 */
void RGB1W_SendRAM( uint16_t total_bytes, uint8_t *p_source_addr ,uint8_t mod) {//RAM mode for 1~3072 bytes data
// p_source_addr: point source data buffer start address, set NULL if copy into PIOC buffer already
	if ( total_bytes > RGB1W_RAM_SIZE ) return;
	PIOC->D8_SYS_CFG = RB_MST_RESET | RB_MST_IO_EN0| RB_MST_IO_EN1;//clear&halt PIOC
	if ( p_source_addr ) memcpy( RGB1W_RAM_ADDR, p_source_addr, total_bytes );//copy source data to PIOC SRAM, @PIOC halt
	PIOC->D8_SYS_CFG = RB_MST_CLK_GATE | RB_MST_IO_EN0| RB_MST_IO_EN1;//run PIOC after load data in SRAM
	PIOC->D16_DATA_REG0_1 = total_bytes;// data size
	if(mod)
	    PIOC->D8_DATA_REG2 = 1;
	else
	    PIOC->D8_DATA_REG2 = 0;

#if defined SYSCLK_FREQ_24MHz_HSI
	RGB1W_COMMAND = RGB1W_CYC_24M | RGB1W_CMD_RAM;// set bit cycle and PIOC start send
#else	// default is 48MHz
	RGB1W_COMMAND = RGB1W_CYC_48M | RGB1W_CMD_RAM;// set bit cycle and PIOC start send
#endif

}

/*********************************************************************
 * @fn      RGB1W_SendSFR_Wait
 *
 * @brief   SFR mode for 1~3072 bytes data wait PIOC operate finish.
 *
 * @param   total_bytes - total data number(byte).
 *          p_source_addr - data.
 *          mod - 0:PC18 or PC7
 *                1:PC19
 * @return  none
 */
uint8_t RGB1W_SendSFR_Wait( uint16_t total_bytes, uint8_t *p_source_addr ,uint8_t mod) {//SFR mode for 1~32 bytes data
// p_source_addr: point source data buffer start address, set NULL if copy into PIOC buffer already
	if ( total_bytes == 0 || total_bytes > RGB1W_SFR_SIZE ) return( RGB1W_ERR_PARA );
	RGB1W_SendSFR( total_bytes, p_source_addr , mod);
	while ( ( PIOC->D8_SYS_CFG & RB_INT_REQ ) == 0 );//wait, PIOC request interrupt after finish
	return( PIOC->D8_CTRL_RD );//auto remove interrupt request after reading
}

/*********************************************************************
 * @fn      RGB1W_SendRAM_Wait
 *
 * @brief   RAM mode for 1~3072 bytes data wait PIOC operate finish.
 *
 * @param   total_bytes - total data number(byte).
 *          p_source_addr - data.
 *          mod - 0:PC18 or PC7
 *                1:PC19
 * @return  none
 */
uint8_t RGB1W_SendRAM_Wait( uint16_t total_bytes, uint8_t *p_source_addr ,uint8_t mod) {//RAM mode for 1~3072 bytes data
// p_source_addr: point source data buffer start address, set NULL if copy into PIOC buffer already
	if ( total_bytes == 0 || total_bytes > RGB1W_RAM_SIZE ) return( RGB1W_ERR_PARA );
	RGB1W_SendRAM( total_bytes, p_source_addr ,mod);
	while ( ( PIOC->D8_SYS_CFG & RB_INT_REQ ) == 0 );//wait, PIOC request interrupt after finish
	return( PIOC->D8_CTRL_RD );//auto remove interrupt request after reading
}

/*********************************************************************
 * @fn      RGB1W_Halt
 *
 * @brief   halt/sleep PIOC .
 *
 * @return  none
 */
void RGB1W_Halt( void ) {//halt/sleep PIOC
	PIOC->D8_SYS_CFG &= ~ RB_MST_CLK_GATE;
}

